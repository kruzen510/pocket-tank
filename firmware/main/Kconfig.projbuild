## firmware/main/Kconfig.projbuild
```kconfig
menu "pocket-tank"
    config POCKET_TANK_BOARD_LCD169
        bool "Board: Waveshare ESP32-S3-(Touch-)LCD-1.69 (ST7789 240x280) instead of the AMOLED-1.8"
        default n
        help
            Drives the 1.69in LCD board: ST7789V2 over SPI (the tank scaled to 280x240),
            CST816T touch, battery by ADC, the PWR key on SYS_OUT / SYS_EN. The ES8311
            audio port cannot be used on this board (its I2S pins are the LCD's).
            Build with: idf.py -D SDKCONFIG_DEFAULTS="sdkconfig.defaults;sdkconfig.defaults.lcd169" build
    config POCKET_TANK_SCREEN_IDLE_S
        int "Screen off after this many seconds without being handled (0 = never)"
        range 0 3600
        default 0
        help
            The panel and backlight go dark when nobody has touched, pressed or carried the device for this
            long (the tank's own idle clock: a touch, a button, or the IMU feeling it handled - a pick-up, not
            a knock on the desk) and light again the moment any of those happens. The tank keeps running
            while dark. Needs the IMU: without one the screen stays on. 0 leaves the screen always on.
    config POCKET_TANK_DISPLAY_SH8601
        bool "Drive the Waveshare 1.8in AMOLED (SH8601 / CO5300 over QSPI)"
        default n
        help
            Enable for the real board. Off = stub display port (QEMU / compile-only).
    config POCKET_TANK_TOUCH_FT3168
        bool "Read the FT3168 capacitive touch (taps / holds)"
        default n
    config POCKET_TANK_AUDIO_ES8311
        bool "Play the sound bank through the ES8311 codec + NS4150B amp (I2S)"
        default n
        help
            Enable for the real board (docs/AUDIO.md). Off = stub audio port: cues compile, nothing plays.
    config POCKET_TANK_NO_PIE
        bool "Disable the PIE SIMD inference kernel (scalar dot products)"
        default n
        help
            Enable for a QEMU build if the emulator lacks ESP32-S3 PIE support.
endmenu
```
